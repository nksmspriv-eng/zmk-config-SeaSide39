#include "SeaSide39.dtsi"

/* Trackball listener (L側ダミー) */
 / {
    trackball_listener: trackball_listener {
        compatible = "zmk,input-listener";
        status = "disabled";
    };
};


&kscan0 {
        col-gpios
            = <&xiao_d 10 GPIO_ACTIVE_HIGH>
            , <&xiao_d 9 GPIO_ACTIVE_HIGH> 
            , <&xiao_d 8 GPIO_ACTIVE_HIGH> 
            , <&xiao_d 7 GPIO_ACTIVE_HIGH> 
            , <&xiao_d 5 GPIO_ACTIVE_HIGH>
            , <&xiao_d 0 GPIO_ACTIVE_HIGH>
            ;
};
